#include <EEPROM.h>
#include <Wire.h>
#include <LedControl.h>

//Switch
#define SW1 2
#define SW2 3
bool lastInput1;
bool lastInput2;
bool currentInput1;
bool currentInput2;

//DOT MATRIX
byte device = 4;
LedControl lc = LedControl(4,5,6,device);	//DIN, CLK, CS, count of displays

//RTC
#define DS3231_I2C_ADDRESS 0x68 //address DS3231 
byte second,minute,hour,dayOfWeek,dayOfMonth,month,year;

//SYSTEM STATE
byte System_State;

//Timming
unsigned long currentTime;
unsigned long ScreenTime;

byte lighting = 0;
bool showDots;

byte ASCII[95][8] = {
{ 0x00, 0x00, 0x00, 0x00, 0x00, 0x00, 0x00, 0x00 },   // (space)
{ 0x18, 0x3C, 0x3C, 0x18, 0x18, 0x00, 0x18, 0x00 },   // (!)
{ 0x36, 0x36, 0x00, 0x00, 0x00, 0x00, 0x00, 0x00 },   // (")
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{ 0x6E, 0x3B, 0x00, 0x00, 0x00, 0x00, 0x00, 0x00 },   // (~)
};

void Clock() {
  Draw(3, 35, 0);  //C
  Draw(2, 44, 0);  //L
  Draw(1, 47, 0);  //O
  Draw(0, 43, 0);  //K
  delay(2000);
}

void WriteTime() {
  if (System_State == 0 || System_State == 2){
   uint8_t hour12 = hour%12 == 0? 12 : hour%12;
    Draw(2, (hour12 % 10) + 16, 0);
    Draw(3, (hour12 / 10) + 16, 0);
  }

  if (System_State == 0 || System_State == 3){
    Draw(0, (minute % 10) + 16, 1);
    Draw(1, (minute / 10) + 16, 1);
  }
  
  //กระพริบ dot บนหน้าจอ
  lc.setLed(2, 1, 7, showDots);  //addr, row, column
  lc.setLed(2, 2, 7, showDots);
  lc.setLed(2, 5, 7, showDots);
  lc.setLed(2, 6, 7, showDots);
  showDots = !showDots;
}

void Draw(byte adr, byte symbol, byte offset) {
  for (int i = 0; i <= 7; i++) {
    byte dataRow = ASCII[symbol][i];
    dataRow = Revers(dataRow) >> offset;
    lc.setRow(adr, i, dataRow);
  }
}

byte Revers(byte in) {
  //กลับด้านตัวอักษร
  byte out;
  out = 0;
  if (in & 0x01) out |= 0x80;
  if (in & 0x02) out |= 0x40;
  if (in & 0x04) out |= 0x20;
  if (in & 0x08) out |= 0x10;
  if (in & 0x10) out |= 0x08;
  if (in & 0x20) out |= 0x04;
  if (in & 0x40) out |= 0x02;
  if (in & 0x80) out |= 0x01;
  return(out);
}

byte decToBcd(byte val) {
  return((val / 10 * 16) + (val % 10));
}

byte bcdToDec(byte val) {
  return((val / 16 * 10) + (val % 16));
}

void SetRtc(byte second, byte minute, byte hour, byte dayOfWeek, byte dayOfMonth, byte month, byte year) {
  Wire.beginTransmission(DS3231_I2C_ADDRESS);
  Wire.write(0); //set 0
  Wire.write(decToBcd(second)); //set sec
  Wire.write(decToBcd(minute)); //set min
  Wire.write(decToBcd(hour)); //set hours
  Wire.write(decToBcd(dayOfWeek)); //set day of week
  Wire.write(decToBcd(dayOfMonth)); //set day of month
  Wire.write(decToBcd(month)); //set month
  Wire.write(decToBcd(year)); //set year
  Wire.endTransmission();
}

void GetRtc() {
  Wire.beginTransmission(DS3231_I2C_ADDRESS);
  Wire.write(0);
  Wire.endTransmission();
  Wire.requestFrom(DS3231_I2C_ADDRESS, 7);
  second = bcdToDec(Wire.read() & 0x7f);
  minute = bcdToDec(Wire.read());
  hour = bcdToDec(Wire.read() & 0x3f);
  dayOfWeek = bcdToDec(Wire.read());
  dayOfMonth = bcdToDec(Wire.read());
  month = bcdToDec(Wire.read());
  year = bcdToDec(Wire.read());
}

void setup() {
	Wire.begin();
	Serial.begin(9600);
	pinMode(SW1, INPUT_PULLUP);
	pinMode(SW2, INPUT_PULLUP);

	lighting = EEPROM.read(0);	//load lighting(EEPROM)
	delay(10);

  //set display
	for (byte address = 0; address<device; address++) {
		lc.shutdown(address, false);
		lc.setIntensity(address, lighting);	//set lighing 0 - 15
		lc.clearDisplay(address);		//clear display
	}
  Clock();
}

void loop() {
	currentInput1 = digitalRead(SW1); 
	currentInput2 = digitalRead(SW2);
  
	switch (System_State){
	case 0:
		//แสดงเวลาจริง
		currentTime = millis();

		if (currentTime - ScreenTime >= 500) {
			ScreenTime = currentTime;
			GetRtc();		//อ่านค่าเวลาจริง
			WriteTime();	//เขียนเวลาจากที่อ่านลงบนหน้าจอ
		}

		if (!currentInput1 && !currentInput2) {
		  delay(20);
			System_State = 1;
		}
		break;

	case 1:
		if (currentInput1 && currentInput2) {
    delay(20);
			System_State = 2; //เปิดเมนู
			
			Draw(1, 0, 0);	//space
			Draw(0, 40, 0);	//H
		}
		break;

	case 2:
		//เมนูที่ 1 กำหนดชั่วโมง(H)
		WriteTime();

		if (currentInput1 != lastInput1) {
			//กด SW1
      delay(20);
			if (currentInput1) {
        delay(20);
				System_State = 3;
				Draw(3, 45, 0);	//M
				Draw(2, 0, 0);	//space
			}
		}

		if (currentInput2 != lastInput2) {
			//กด SW2
      delay(20);
			if (currentInput2) {
				hour++;
				if (hour > 23) {
					hour = 0;
				}
			}
		}
		break;

	case 3:
		//เมนูที่ 2 กำหนดนาที(M)
		WriteTime();

		if (currentInput1 != lastInput1) {
      delay(20);
			//กด SW1
			if (currentInput1) {
				System_State = 4;
        Draw(3, 44, 0); //L
				Draw(2, 0, 0);	//space
				Draw(0, (lighting % 10) + 16, 1);
				Draw(1, (lighting / 10) + 16, 1);
			}
		}

		if (currentInput2 != lastInput2) {
      delay(20);
			//กด SW2
			if (currentInput2) {
				minute++;
				if (minute > 59) {
					minute = 0;
				}
			}
		}
		break;

	case 4:
		//เมนูที่ 3 กำหนดระดับความสว่าง(L)
   
		if (currentInput1 != lastInput1) {
			//กด SW1
      delay(20);
			if (currentInput1) {
				System_State = 5;
				Draw(3, 83, 0);	//S
				Draw(2, 84, 0);	//t
				Draw(1, 82, 0);	//r
				Draw(0, 84, 0);	//t
			}
		}

		if (currentInput2 != lastInput2) {
			//กด SW2
      delay(20);
			if (currentInput2) 
			{
				lighting++;
				if (lighting > 15) 
				{
					lighting = 0;			
				}
				Draw(0, (lighting % 10) + 16, 1);
				Draw(1, (lighting / 10) + 16, 1);

				for (byte address = 0; address<device; address++) 
				{
					lc.setIntensity(address, lighting);	//set lighting 0 - 15
				}
			}
		}
		break;

	case 5:
		//เมนูสุดท้าย strt
		if (currentInput1 != lastInput1) {
			//กด SW1
      delay(20);
			if (currentInput1) {
				SetRtc(0, minute, hour, dayOfWeek, dayOfMonth, month, year);
				EEPROM.write(0, lighting);
				System_State = 0;
			}
		}
		break;
	}
	lastInput1 = currentInput1;
	lastInput2 = currentInput2;
}
